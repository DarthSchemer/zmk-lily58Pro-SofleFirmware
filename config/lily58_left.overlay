/ {
    chosen {
        zmk,battery = &adc_battery;
    };

    adc_battery: adc_battery {
        compatible = "zmk,battery-voltage-divider";
        io-channels = <&adc 2>;
        output-ohms = <2000000>;
        full-ohms = <2806000>;
    };
};
